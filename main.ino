#include <Wire.h>
#include <WiFiClient.h>
#include <ESP8266mDNS.h>
#include <WiFiUdp.h>
#include <ArduinoOTA.h>
#include <ESP8266WiFi.h>
#include <PubSubClient.h>
#include <SPI.h>
#include <Adafruit_GFX.h>
#include <Adafruit_SSD1306.h>
#include <Fonts/Org_01.h>

#define OLED_RESET 4
Adafruit_SSD1306 display(OLED_RESET);
Adafruit_SSD1306 display2(OLED_RESET);

#define NUMFLAKES 10
#define XPOS 0
#define YPOS 1
#define DELTAY 2


//#define LOGO16_GLCD_HEIGHT 16
//#define LOGO16_GLCD_WIDTH  16

//SSD1306_128_64
int lux = 1000 ;
bool high_lux = false ;

bool debug = false;
const char* mqttServer = "192.168.1.18";
const int mqttPort = 1883;
const char* mqttUser = "";
const char* mqttPassword = "";
char message_buff_temp[100] ;
char message_buff_temp_int[100];
char message_buff_pressure[100];
char message_buff_icone[100];
char message_buff_danger[10] ;
char message_buff_lux[10] ;

unsigned long time;
unsigned long next_time;
unsigned long now;
unsigned long time2;
unsigned long next_time2;
unsigned long now2;

bool monitor = true ;
float temp ;
float humi ;
float float_actual_pressure;
float float_old_pressure ;
int t;
bool first_mesure = true;
String image_trend ;

static const unsigned char PROGMEM danger [] =
{
    // 'danger'
    0x00, 0x00, 0x00, 0x00, 0x00, 0x00, 0x00, 0x00, 0x00, 0x00, 0x00, 0x00, 0x00, 0x03, 0xc0, 0x00,
    0x00, 0x03, 0xc0, 0x00, 0x00, 0x07, 0xe0, 0x00, 0x00, 0x0f, 0xf0, 0x00, 0x00, 0x0f, 0xf0, 0x00,
    0x00, 0x1f, 0xf8, 0x00, 0x00, 0x1f, 0xf8, 0x00, 0x00, 0x3f, 0xfc, 0x00, 0x00, 0x7e, 0x7e, 0x00,
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    0xff, 0xff, 0xff, 0xff, 0x3f, 0xff, 0xff, 0xfc, 0x00, 0x00, 0x00, 0x00, 0x00, 0x00, 0x00, 0x00,
};
static const unsigned char PROGMEM arrowup [] =
{
    // 'arrow-4'
    0x00, 0x00, 0x00, 0x00, 0x00, 0x00, 0x00, 0x00, 0x00, 0x00, 0x00, 0x00, 0x00, 0x00, 0x00, 0x00,
    0x00, 0x00, 0x00, 0x00, 0x00, 0x00, 0x00, 0x00, 0x00, 0x00, 0x00, 0x00, 0x00, 0x03, 0x80, 0x00,
    0x00, 0x07, 0xc0, 0x00, 0x00, 0x0d, 0x60, 0x00, 0x00, 0x19, 0x30, 0x00, 0x00, 0x31, 0x18, 0x00,
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    0x00, 0x00, 0x00, 0x00, 0x00, 0x00, 0x00, 0x00, 0x00, 0x00, 0x00, 0x00, 0x00, 0x00, 0x00, 0x00,
};
static const unsigned char PROGMEM arrowdown [] =
{
    0x00, 0x00, 0x00, 0x00, 0x00, 0x00, 0x00, 0x00, 0x00, 0x00, 0x00, 0x00, 0x00, 0x00, 0x00, 0x00,
    0x00, 0x00, 0x00, 0x00, 0x00, 0x00, 0x00, 0x00, 0x00, 0x01, 0x00, 0x00, 0x00, 0x01, 0x00, 0x00,
    0x00, 0x01, 0x00, 0x00, 0x00, 0x01, 0x00, 0x00, 0x00, 0x01, 0x00, 0x00, 0x00, 0x01, 0x00, 0x00,
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    0x00, 0x00, 0x00, 0x00, 0x00, 0x00, 0x00, 0x00, 0x00, 0x00, 0x00, 0x00, 0x00, 0x00, 0x00, 0x00,
};
static const unsigned char PROGMEM arrow [] =
{
    0x00, 0x00, 0x00, 0x00, 0x00, 0x00, 0x00, 0x00, 0x00, 0x00, 0x00, 0x00, 0x00, 0x00, 0x00, 0x00,
    0x00, 0x00, 0x00, 0x00, 0x00, 0x00, 0x00, 0x00, 0x00, 0x00, 0x00, 0x00, 0x00, 0x00, 0x00, 0x00,
    0x00, 0x00, 0x80, 0x00, 0x00, 0x00, 0x40, 0x00, 0x00, 0x00, 0x20, 0x00, 0x00, 0x00, 0x10, 0x00,
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    0x00, 0x00, 0x00, 0x00, 0x00, 0x00, 0x00, 0x00, 0x00, 0x00, 0x00, 0x00, 0x00, 0x00, 0x00, 0x00,
};
static const unsigned char PROGMEM wifi_icone [] =
{
    // 'wifi'
    0x00, 0x00, 0x00, 0x00, 0x00, 0x00, 0x00, 0x00, 0x00, 0x00, 0x00, 0x00, 0x00, 0x3c, 0x00, 0x01,
    0xff, 0x80, 0x07, 0xff, 0xe0, 0x1f, 0xff, 0xf8, 0x3f, 0x00, 0xfc, 0x3c, 0x00, 0x3c, 0x18, 0xff,
    0x18, 0x03, 0xff, 0xc0, 0x07, 0xff, 0xe0, 0x03, 0x81, 0xc0, 0x01, 0x00, 0x80, 0x00, 0x7e, 0x00,
    0x00, 0x7e, 0x00, 0x00, 0x3c, 0x00, 0x00, 0x18, 0x00, 0x00, 0x00, 0x00, 0x00, 0x00, 0x00, 0x00,
    0x00, 0x00, 0x00, 0x00, 0x00, 0x00, 0x00, 0x00
};
static const unsigned char PROGMEM snow [] =
{
    // 'HA =
    0x00, 0x00, 0x00, 0x00, 0x00, 0x00, 0x00, 0x00, 0x00, 0x8c, 0x31, 0x00, 0x00, 0xcc, 0x33, 0x00,
    0x00, 0xf8, 0x1f, 0x00, 0x00, 0x78, 0x1e, 0x00, 0x07, 0xf0, 0x0f, 0xe0, 0x07, 0xf2, 0x4f, 0xe0,
    0x00, 0x3e, 0x78, 0x00, 0x00, 0x1e, 0x78, 0x00, 0x00, 0x7e, 0x7e, 0x00, 0x30, 0x3e, 0x7c, 0x0c,
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    0x00, 0xcc, 0x33, 0x00, 0x00, 0x8c, 0x31, 0x00, 0x00, 0x00, 0x00, 0x00, 0x00, 0x00, 0x00, 0x00,
};
static const unsigned char PROGMEM thunderstorm [] =
{
    // 'HA =
    0x00, 0x00, 0x00, 0x00, 0x00, 0x00, 0x00, 0x00, 0x00, 0x00, 0x00, 0x00, 0x00, 0x00, 0x00, 0x00,
    0x00, 0x00, 0x00, 0x00, 0x00, 0x00, 0x00, 0x00, 0x00, 0x00, 0x00, 0x00, 0x00, 0x00, 0x00, 0x00,
    0x00, 0x00, 0x00, 0x00, 0x00, 0x00, 0x00, 0x00, 0x00, 0x00, 0x00, 0x00, 0x00, 0x00, 0x00, 0x00,
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    0x00, 0x00, 0x00, 0x00, 0x00, 0x00, 0x00, 0x00, 0x00, 0x00, 0x00, 0x00, 0x00, 0x00, 0x00, 0x00,
};
static const unsigned char PROGMEM unknown [] =
{
    // 'Question_mark'
    0x00, 0x00, 0x00, 0x00, 0x00, 0x00, 0x00, 0x00, 0x00, 0x00, 0x00, 0x00, 0x00, 0x00, 0x00, 0x00,
    0x00, 0x18, 0x18, 0x00, 0x00, 0x3c, 0x3c, 0x00, 0x00, 0x3f, 0xfc, 0x00, 0x00, 0x3f, 0xfc, 0x00,
    0x00, 0x7f, 0xfe, 0x00, 0x00, 0xff, 0xff, 0x00, 0x07, 0xf8, 0x1f, 0xe0, 0x0f, 0xf0, 0x0f, 0xf0,
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    0x00, 0x00, 0x00, 0x00, 0x00, 0x00, 0x00, 0x00, 0x00, 0x00, 0x00, 0x00, 0x00, 0x00, 0x00, 0x00,
};
static const unsigned char PROGMEM partysunnyrainy [] =
{
    // 'HA= 5 || 40 || 41'
    // 'test'
   0x07, 0x00, 0x00, 0x03, 0x80, 0x00, 0x07, 0x80, 0x00, 0x07, 0x80, 0x00, 0x03, 0xc0, 0x00, 0x07,
   0x00, 0x00, 0x01, 0xc0, 0x7c, 0x06, 0x00, 0x00, 0x00, 0x03, 0xff, 0x00, 0x00, 0x00, 0x00, 0x07,
   0xff, 0xc0, 0x00, 0x00, 0x00, 0x0f, 0x83, 0xe0, 0x00, 0x00, 0x00, 0x1e, 0x00, 0xf0, 0x00, 0x00,
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   0x00, 0x00, 0xf8, 0x00, 0x00, 0x1f, 0x00, 0x00, 0x70, 0x00, 0x00, 0x0e, 0x00, 0x00, 0x00, 0x00,
};
static const unsigned char PROGMEM partysunny [] =
{
    // 'HA= 3 || 2'
    0x00, 0x00, 0x00, 0x00, 0x00, 0x00, 0x00, 0x00, 0x00, 0x00, 0x00, 0x00, 0x00, 0x00, 0x00, 0x00,
    0x00, 0x00, 0x00, 0x00, 0x00, 0x00, 0x00, 0x00, 0x00, 0x00, 0x00, 0x00, 0x00, 0x00, 0x00, 0x00,
    0x00, 0x00, 0x00, 0x00, 0x00, 0x00, 0x00, 0x00, 0x00, 0x00, 0x00, 0x00, 0x00, 0x00, 0x00, 0x00,
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    0x00, 0x00, 0x00, 0x00, 0x00, 0x00, 0x00, 0x00, 0x00, 0x00, 0x00, 0x00, 0x00, 0x00, 0x00, 0x00,
};
static const unsigned char PROGMEM sunny [] =
{
    //HA = 1
    0x00, 0x00, 0x00, 0x00, 0x00, 0x00, 0x00, 0x00, 0x00, 0x00, 0x00, 0x00, 0x00, 0x00, 0x00, 0x00,
    0x00, 0x00, 0x00, 0x00, 0x00, 0x00, 0x00, 0x00, 0x00, 0x00, 0x00, 0x00, 0x00, 0x00, 0x00, 0x00,
    0x00, 0x00, 0x00, 0x00, 0x00, 0x00, 0x00, 0x00, 0x00, 0x00, 0x00, 0x00, 0x00, 0x00, 0x00, 0x00,
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    0x00, 0x00, 0x00, 0x00, 0x00, 0x00, 0x00, 0x00, 0x00, 0x00, 0x00, 0x00, 0x00, 0x00, 0x00, 0x00,
};
static const unsigned char PROGMEM rainy [] =
{   //HA = 9 || 46
    0x00, 0x00, 0x00, 0x00, 0x00, 0x00, 0x00, 0x00, 0x00, 0x00, 0x00, 0x00, 0x00, 0x00, 0x00, 0x00,
    0x00, 0x00, 0x00, 0x00, 0x00, 0x00, 0x00, 0x00, 0x00, 0x00, 0x00, 0x00, 0x00, 0x00, 0x00, 0x00,
    0x00, 0x00, 0x00, 0x00, 0x00, 0x00, 0x00, 0x00, 0x00, 0x00, 0x00, 0x00, 0x00, 0x00, 0x00, 0x00,
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    0x00, 0x00, 0x00, 0x00, 0x00, 0x00, 0x00, 0x00, 0x00, 0x00, 0x00, 0x00, 0x00, 0x00, 0x00, 0x00,
};
static const unsigned char PROGMEM cloudy [] =
{    //HA = 4
     0x00, 0x00, 0x00, 0x00, 0x00, 0x00, 0x00, 0x00, 0x00, 0x00, 0x00, 0x00, 0x00, 0x00, 0x00, 0x00,
     0x00, 0x00, 0x00, 0x00, 0x00, 0x00, 0x00, 0x00, 0x00, 0x00, 0x00, 0x00, 0x00, 0x00, 0x00, 0x00,
     0x00, 0x00, 0x00, 0x00, 0x00, 0x00, 0x00, 0x00, 0x00, 0x00, 0x00, 0x00, 0x00, 0x00, 0x00, 0x00,
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     0x00, 0x00, 0x00, 0x00, 0x00, 0x00, 0x00, 0x00, 0x00, 0x00, 0x00, 0x00, 0x00, 0x00, 0x00, 0x00,
};

WiFiClient espClient;
PubSubClient client(espClient);

void setup() {

    Serial.begin(115200);
    pinMode(5, INPUT);
    pinMode(13, INPUT_PULLUP);
    //Starting Display
    Wire.begin(2,14);
    display.begin(SSD1306_SWITCHCAPVCC, 0x3C); // initialize with the I2C addr 0x3C (for the 128x32)
    display2.begin(SSD1306_SWITCHCAPVCC, 0x3D); // initialize with the I2C addr 0x3D (for the 128x32)
    display.display();
    display2.display();

    delay(1000);
    display.clearDisplay();
    display2.clearDisplay();
    display.setCursor(0,0);
    display2.setCursor(0,0);
    display.setTextSize(1);
    display2.setTextSize(1);
    display.setTextColor(WHITE);
    display2.setTextColor(WHITE);
   // display.setFont(&Org_01);
 //   display2.setFont(&Org_01);
    delay(500);
    display.println("Attempting ");
    display.println("wifi connection...");
    display.display();
    //display.startscrollright(0x00, 0x0F);

    WiFi.mode(WIFI_STA);
    WiFi.begin(ssid, password);

    while (WiFi.status() != WL_CONNECTED) {
        delay(500);

        if (debug) Serial.println("Connecting to WiFi..");
    }
    if (debug) Serial.println("Connected to the WiFi network");


    display.clearDisplay();
    //display.setCursor(0,0);
    delay(500);
    display.println("Wifi connected on");
    display.println(String (ssid));
    display.print("IP: ");
    display.println(WiFi.localIP());
    display.print("awaiting data...");
    display.display();
    delay(2000);

    client.setServer(mqttServer, mqttPort);
    client.setCallback(callback);
    client.subscribe("sensor/#");

    next_time = millis();

    ///////////////////////////**********OTA Upgrade**********////////////////////
    ArduinoOTA.onStart([]() {
        //
        Serial.println("Start");
    });
    ArduinoOTA.onEnd([]() {
        Serial.println("\nEnd");
    });
    ArduinoOTA.onProgress([](unsigned int progress, unsigned int total) {
        Serial.printf("Progress: %u%%\r", (progress / (total / 100)));
    });
    ArduinoOTA.onError([](ota_error_t error) {
        Serial.printf("Error[%u]: ", error);
        if (error == OTA_AUTH_ERROR) Serial.println("Auth Failed");
        else if (error == OTA_BEGIN_ERROR) Serial.println("Begin Failed");
        else if (error == OTA_CONNECT_ERROR) Serial.println("Connect Failed");
        else if (error == OTA_RECEIVE_ERROR) Serial.println("Receive Failed");
        else if (error == OTA_END_ERROR) Serial.println("End Failed");
        ESP.restart();
    });
    ArduinoOTA.begin();
    /////////////////////////////////////////////////////////////////////////////

}

void reconnect() {
    int a = 1 ;
    //loop until connected
    if (WiFi.status() == WL_CONNECTED) {
        while (!client.connected()) {
            yield();
            if (debug) Serial.print("MQTT attempting connection...");
            if (client.connect("ESP8266Client", mqttUser, mqttPassword)) {
                if (debug)  Serial.println("OK");
                client.subscribe("sensor/#");

            } else {
                if (debug) Serial.print("KO, error : ");
                if (debug) Serial.print(client.state());
                if (debug) Serial.println(" delay 5 s before trying to reconnect");
                delay(5000);
            }
            a++ ;
            if (a > 5){
                break ; // in order to avoid an infernal loop
            }
        }
    }
}


void display_msg(char* msg1, char* msg2, char* msg3, char* msg4, char*msg5) {
    yield();
    delay(800);
    //Display2 image
    display2.clearDisplay();
    String msg_icone = String(msg4);

    if (msg_icone == "4" || (msg_icone == "15")) {
        display2.drawBitmap(-5, -14 ,cloudy , 96, 96 , 1);

    } else if (msg_icone == "1") {
        display2.drawBitmap(-5, -13 ,sunny , 96, 96 , 1);

    } else if ((msg_icone == "49") || (msg_icone == "50") || (msg_icone == "13") || (msg_icone == "12")) {
        display2.drawBitmap(15, 30 ,snow , 32, 32 , 1);

    } else if ((msg_icone =="3") || (msg_icone =="2"))  {
        display2.drawBitmap(-5, -15 ,partysunny , 96, 96 , 1);

    } else if ((msg_icone =="9") || (msg_icone == "46") || (msg_icone =="10")) {
        display2.drawBitmap(-5, -8 ,rainy , 96, 96 , 1);

    } else if ((msg_icone =="5") || (msg_icone == "40") || (msg_icone =="41")) {
        display2.drawBitmap(5, 10 ,partysunnyrainy , 48, 48 , 1);

    } else {
        display2.drawBitmap(0, 30 ,unknown , 32, 32 , 1);
    };

    if (monitor) {
        display2.drawBitmap(100, 0 ,wifi_icone, 24, 24, 1);
    }
    String msg_danger = String(msg5);
    if (msg_danger != "0" ){
        display2.drawBitmap(90, 35 ,danger , 32, 32 , 1);
    }
    if (image_trend == "up"){
        display.drawBitmap(-12, -4 ,arrowup, 32, 32 , 1);
    }
    if (image_trend == "down"){
        display.drawBitmap(-12, -4 ,arrowdown, 32, 32 , 1);
    }
    if (image_trend == "none"){
        display.drawBitmap(-12, -4 ,arrow, 32, 32 , 1);
    }
    if (!high_lux) {
        display.setCursor(90,20);
        display.setTextSize(1);
        // display.setTextColor(WHITE);
        display.print("autoON");
    } else if (high_lux){
        display.setCursor(86,20);
        display.setTextSize(1);
        display.print("");
    }
    display2.display();

    //Display1
    delay(800);
    display.clearDisplay();
    display.setTextSize(2);
    //display msg1
    String msgString_pressure = String(msg1);
    display.setCursor(0,0);
    display.setTextColor(WHITE);
    display.print(msgString_pressure);
    display.println(" hPa");
    //Display msg2
    delay(800);
    String msgString_temp = String(msg2);
    display.setCursor(0,20);
    // display.setTextSize(1);
    display.setTextColor(WHITE);
    display.print("Ext: ");
    display.print(msgString_temp);
    //  display.println(" Degres");
    //Display msg3
    delay(800);
    String msgString_temp_int = String(msg3);
    display.setCursor(0,40);
    // display.setTextColor(WHITE);
    display.print("Int: ");
    display.print(msgString_temp_int);
    //display.println(" Degres");
    delay(800);
    display.display();
    // delay(8000);
}

void callback(char* topic, byte* payload, unsigned int length) {

    yield();
    monitor = true;
    next_time = millis();
    String strTopic = String((char*)topic);
    int i = 0;

    if (debug){
        Serial.print("Message arrived in topic: ");
        Serial.println(topic);
        Serial.print("Message:");
        for (int i = 0; i < length; i++) {
            Serial.print((char)payload[i]);
        }
        Serial.println();
        Serial.println("-----------------------");
    }

    if (strTopic == "sensor/pressure") {
        for(i=0; i<length; i++) {
            message_buff_pressure[i] = payload[i];
        }
        message_buff_pressure[i] = '\0';

        //tendance
        String msgString = String(message_buff_pressure);
        float_actual_pressure = msgString.toFloat();
        if (first_mesure){
            float_old_pressure = float_actual_pressure ;
            first_mesure = false;
        }
        trend();
        //String msgStringpressure = String(message_buff);
    }

    if (strTopic == "sensor/temp") {
        for(i=0; i<length; i++) {
            message_buff_temp[i] = payload[i];
        }
        message_buff_temp[i] = '\0';
        //String msgStringtemp = String(message_buff);
    }
    if (strTopic == "sensor/temp_int") {
        for(i=0; i<length; i++) {
            message_buff_temp_int[i] = payload[i];
        }
        message_buff_temp_int[i] = '\0';
        //String msgStringtemp = String(message_buff);
    }

    if (strTopic == "sensor/icone") {
        for(i=0; i<length; i++) {
            message_buff_icone[i] = payload[i];
        }
        message_buff_icone[i] = '\0';
        // String msgStringtemp = String(message_buff);
    }

    if (strTopic == "sensor/lux") {
        for(i=0; i<length; i++) {
            message_buff_lux[i] = payload[i];
        }
        message_buff_lux[i] = '\0';
        String buff_lux = String(message_buff_lux);
        lux  =atoi( buff_lux.c_str() ) ;
        // String msgStringtemp = String(message_buff);
    }

    if (strTopic == "sensor/danger") {
        for(i=0; i<length; i++) {
            message_buff_danger[i] = payload[i];
        }
        message_buff_danger[i] = '\0';
        // String msgStringtemp = String(message_buff);
    }

    display_msg(message_buff_pressure, message_buff_temp, message_buff_temp_int, message_buff_icone, message_buff_danger) ;

}


void counter() {
    //if non data received under 5 minutes, clear icone
    now = millis();
    time =  now - next_time ;
    if (time >= 300000){
        monitor = false ;
        delay(500);
        display_msg(message_buff_pressure, message_buff_temp, message_buff_temp_int, message_buff_icone, message_buff_danger) ;
    }
}

void trend (){
    t++ ;
    if (t > 5) {
        float dif = float_old_pressure - float_actual_pressure ;
        if ( (dif > 0.5 ) || (dif < -0.5) ) {
            if (float_old_pressure > float_actual_pressure) {
                image_trend = "down" ;
            } else {
                image_trend = "up" ;
            }
            float_old_pressure = float_actual_pressure ;
            t = -5 ;
        } else {
            image_trend = "none" ;
            float_old_pressure = float_actual_pressure ;
            t = 0 ;
        }
    }
}


void loop() {

    ///////********OTA Upgrade*********/////////////////
    ArduinoOTA.handle();
    ////////////////////////////////////////////////////

   if (!client.connected()) {
        reconnect();
   }

   if (monitor){
   counter();
   }

   client.loop();
   now2 = millis();

   if (lux < 240 && lux >= 0 ) {
       high_lux = false;
   } else {
       high_lux = true;
   }

   if (now2 - time2 > 150000) {   // do not flood if somebody is detected , wait 2.30 minutes
       if (digitalRead(5) == HIGH) {
           now2 = millis();
           if (lux >= 0){
           client.publish("ESP/all_switches", "ON");
           delay(800);
           display_msg(message_buff_pressure, message_buff_temp, message_buff_temp_int, message_buff_icone, message_buff_danger) ;
           time2 = now2 ;
           }
       }
   }


    if (digitalRead(13) == LOW ){
        client.publish("ESP/all_switches", "OFF");
        delay(800);
    }


}
